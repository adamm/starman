## firmware/sdkconfig.defaults
```kconfig
CONFIG_BT_ENABLED=n

CONFIG_ESPTOOLPY_FLASHSIZE_8MB=y

CONFIG_PARTITION_TABLE_CUSTOM=y
CONFIG_PARTITION_TABLE_CUSTOM_FILENAME="partitions.csv"
CONFIG_PARTITION_TABLE_FILENAME="partitions.csv"
CONFIG_PARTITION_TABLE_CUSTOM=y

CONFIG_WEBAPP_LOCATION="/wifi/"
CONFIG_DEFAULT_AP_SSID="starman"
CONFIG_DEFAULT_AP_PASSWORD=""

CONFIG_HTTPD_MAX_REQ_HDR_LEN=1024
CONFIG_HTTPD_MAX_URI_LEN=1024

CONFIG_FREERTOS_ENABLE_BACKWARD_COMPATIBILITY=y
```

## sdkconfig.defaults
```kconfig
# Override some defaults so BT stack is enabled and
CONFIG_BT_ENABLED=y
CONFIG_BTDM_CTRL_MODE_BLE_ONLY=y
CONFIG_BTDM_CTRL_MODE_BR_EDR_ONLY=n
CONFIG_BTDM_CTRL_MODE_BTDM=n
CONFIG_BT_NIMBLE_ENABLED=y

CONFIG_ESPTOOLPY_FLASHSIZE_8MB=y

CONFIG_PARTITION_TABLE_CUSTOM=y
CONFIG_PARTITION_TABLE_CUSTOM_FILENAME="partitions.csv"
CONFIG_PARTITION_TABLE_FILENAME="partitions.csv"
CONFIG_PARTITION_TABLE_CUSTOM=y

CONFIG_WEBAPP_LOCATION="/wifi/"
CONFIG_DEFAULT_AP_SSID="starman"
CONFIG_DEFAULT_AP_PASSWORD=""
```
